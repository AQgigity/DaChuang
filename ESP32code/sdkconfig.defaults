## ESP32code/sdkconfig.defaults
```kconfig
# ===== Bluetooth / NimBLE =====
CONFIG_BT_ENABLED=y
CONFIG_BT_NIMBLE_ENABLED=y
CONFIG_BT_NIMBLE_ROLE_PERIPHERAL=y
CONFIG_BT_NIMBLE_ROLE_BROADCASTER=n
CONFIG_BT_NIMBLE_ROLE_CENTRAL=n
CONFIG_BT_NIMBLE_ROLE_OBSERVER=n
CONFIG_BT_NIMBLE_MAX_CONNECTIONS=1
CONFIG_BT_NIMBLE_ATT_PREFERRED_MTU=247
CONFIG_BT_NIMBLE_NVS_PERSIST=n
CONFIG_BT_NIMBLE_SM_LEGACY_PAIRING=n
CONFIG_BT_NIMBLE_SM_SC=n
CONFIG_BT_NIMBLE_MAX_CCCDS=8
CONFIG_BT_NIMBLE_MSYS1_BLOCK_COUNT=12
CONFIG_BT_NIMBLE_ACL_BUF_COUNT=8
CONFIG_BT_NIMBLE_ACL_BUF_SIZE=256

# ===== System =====
CONFIG_ESP_MAIN_TASK_STACK_SIZE=8192
CONFIG_NEWLIB_NANO_FORMAT=n
CONFIG_ESP32S3_DEFAULT_CPU_FREQ_MHZ_240=y
CONFIG_ESP_TASK_WDT_TIMEOUT_S=10
```

## Watch_code/sdkconfig.defaults
```kconfig
CONFIG_IDF_TARGET="esp32s3"
CONFIG_FREERTOS_HZ=1000
CONFIG_SPI_MASTER_IN_IRAM=y

# ===== Flash =====
CONFIG_ESPTOOLPY_FLASHSIZE_16MB=y
CONFIG_ESPTOOLPY_FLASHSIZE="16MB"

# ===== Partition Table =====
CONFIG_PARTITION_TABLE_CUSTOM=y
CONFIG_PARTITION_TABLE_CUSTOM_FILENAME="partitions.csv"

# ===== Bluetooth / NimBLE =====
CONFIG_BT_ENABLED=y
CONFIG_BT_NIMBLE_ENABLED=y
CONFIG_BT_NIMBLE_ROLE_PERIPHERAL=n
CONFIG_BT_NIMBLE_ROLE_BROADCASTER=n
CONFIG_BT_NIMBLE_ROLE_CENTRAL=y
CONFIG_BT_NIMBLE_ROLE_OBSERVER=y
CONFIG_BT_NIMBLE_MAX_CONNECTIONS=2
CONFIG_BT_NIMBLE_ATT_PREFERRED_MTU=247
CONFIG_BT_NIMBLE_NVS_PERSIST=n
CONFIG_BT_NIMBLE_SM_LEGACY_PAIRING=n
CONFIG_BT_NIMBLE_SM_SC=n
CONFIG_BT_NIMBLE_MAX_CCCDS=8
CONFIG_BT_NIMBLE_MSYS1_BLOCK_COUNT=12
CONFIG_BT_NIMBLE_ACL_BUF_COUNT=8
CONFIG_BT_NIMBLE_ACL_BUF_SIZE=256

# ===== WiFi =====
CONFIG_ESP_WIFI_STATIC_RX_BUFFER_NUM=6
CONFIG_ESP_WIFI_DYNAMIC_RX_BUFFER_NUM=12
CONFIG_ESP_WIFI_RX_BA_WIN=6

# ===== MQTT =====
CONFIG_MQTT_PROTOCOL_311=y
```
